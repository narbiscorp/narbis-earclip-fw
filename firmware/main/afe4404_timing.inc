/*
 * afe4404_timing.inc - GENERATED by tools/goldens/gen_afe_timing.py.  DO NOT EDIT.
 *
 * AFE4404 (TI SBAS689D) timing-engine register tables, one per
 * nc_rate_t index (0..4 = 50/100/200/250/500 sps). Include AFTER the
 * afe_regval_t / afe_rate_cfg_t typedefs (firmware/main/afe4404_regs.h).
 * Data + comments only: no typedefs, no preprocessor.
 *
 * Construction (window duration = END - ST + 1 ticks; tick = DIV/4MHz):
 *  - 4 sample phases in datasheet default order RED(LED2), ambient-2,
 *    IR(LED1), ambient-1; sample 100 us (70 us at 500 sps: 10% LED
 *    duty abs-max); LED drive leads sampling by t1 >= 25 us (Table 7);
 *    4-tick gaps between phases.
 *  - 4 conversions back-to-back after sampling, each preceded by its
 *    6-tick ADCRSTx window; convert >= (NUMAV+2)*200*tADC + 15 us
 *    (tADC = 250 ns); ADC_RDY is generated from ALED1CONVEND (4th).
 *  - Dynamic power-down at 50/100 sps only: PDNCYCLE >= 200 us after
 *    ALED1CONVEND and >= 200 us before frame end; CONTROL2 DYNAMIC1..4.
 *  - 50 sps uses CLKDIV /2 (16-bit PRPCT overflow and 61 Hz engine
 *    floor at /1).
 *
 * Regenerate: python tools/goldens/gen_afe_timing.py
 * Verify:     python tools/goldens/gen_afe_timing.py --check
 */

/* -------------------------------------------------------------------- *
 * 50 sps: CLKDIV /2 (field 4), tick 500 ns, PRPCT 39999 (frame 40000 ticks = 20000 us)
 * NUMAV 15 (16 averages) -> convert >= 865.00 us = 1730 ticks; sample 100 us = 200 ticks
 * dynamic power-down: ON
 * -------------------------------------------------------------------- */
static const afe_regval_t afe_regs_50[] = {
    { 0x39, 0x000004 }, /* CLKDIV_PRF   = 4: divide-by-2, tick = 500 ns (codes 1,2,3 forbidden) */
    { 0x01, 0x000032 }, /* LED2STC      =    50 (    25.00 us)  RED sample start */
    { 0x02, 0x0000F9 }, /* LED2ENDC     =   249 (   124.50 us)  RED sample end: 200 ticks = 100.00 us */
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    { 0x23, 0x104218 }, /* CONTROL2: OSC_ENABLE(b9) | DYNAMIC1(b20)|DYNAMIC2(b14)|DYNAMIC3(b4)|DYNAMIC4(b3); ILED_2X(b17)=0 ALWAYS, PDNAFE(b0)=PDNRX(b1)=0 */
};

/* -------------------------------------------------------------------- *
 * 100 sps: CLKDIV /1 (field 0), tick 250 ns, PRPCT 39999 (frame 40000 ticks = 10000 us)
 * NUMAV 15 (16 averages) -> convert >= 865.00 us = 3460 ticks; sample 100 us = 400 ticks
 * dynamic power-down: ON
 * -------------------------------------------------------------------- */
static const afe_regval_t afe_regs_100[] = {
    { 0x39, 0x000000 }, /* CLKDIV_PRF   = 0: divide-by-1, tick = 250 ns (codes 1,2,3 forbidden) */
    { 0x01, 0x000064 }, /* LED2STC      =   100 (    25.00 us)  RED sample start */
    { 0x02, 0x0001F3 }, /* LED2ENDC     =   499 (   124.75 us)  RED sample end: 400 ticks = 100.00 us */
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    { 0x23, 0x104218 }, /* CONTROL2: OSC_ENABLE(b9) | DYNAMIC1(b20)|DYNAMIC2(b14)|DYNAMIC3(b4)|DYNAMIC4(b3); ILED_2X(b17)=0 ALWAYS, PDNAFE(b0)=PDNRX(b1)=0 */
};

/* -------------------------------------------------------------------- *
 * 200 sps: CLKDIV /1 (field 0), tick 250 ns, PRPCT 19999 (frame 20000 ticks = 5000 us)
 * NUMAV 15 (16 averages) -> convert >= 865.00 us = 3460 ticks; sample 100 us = 400 ticks
 * dynamic power-down: off
 * -------------------------------------------------------------------- */
static const afe_regval_t afe_regs_200[] = {
    { 0x39, 0x000000 }, /* CLKDIV_PRF   = 0: divide-by-1, tick = 250 ns (codes 1,2,3 forbidden) */
    { 0x01, 0x000064 }, /* LED2STC      =   100 (    25.00 us)  RED sample start */
    { 0x02, 0x0001F3 }, /* LED2ENDC     =   499 (   124.75 us)  RED sample end: 400 ticks = 100.00 us */
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    { 0x23, 0x000200 }, /* CONTROL2: OSC_ENABLE(b9); ILED_2X(b17)=0 ALWAYS, PDNAFE(b0)=PDNRX(b1)=0 */
};

/* -------------------------------------------------------------------- *
 * 250 sps: CLKDIV /1 (field 0), tick 250 ns, PRPCT 15999 (frame 16000 ticks = 4000 us)
 * NUMAV 15 (16 averages) -> convert >= 865.00 us = 3460 ticks; sample 100 us = 400 ticks
 * dynamic power-down: off
 * -------------------------------------------------------------------- */
static const afe_regval_t afe_regs_250[] = {
    { 0x39, 0x000000 }, /* CLKDIV_PRF   = 0: divide-by-1, tick = 250 ns (codes 1,2,3 forbidden) */
    { 0x01, 0x000064 }, /* LED2STC      =   100 (    25.00 us)  RED sample start */
    { 0x02, 0x0001F3 }, /* LED2ENDC     =   499 (   124.75 us)  RED sample end: 400 ticks = 100.00 us */
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    { 0x23, 0x000200 }, /* CONTROL2: OSC_ENABLE(b9); ILED_2X(b17)=0 ALWAYS, PDNAFE(b0)=PDNRX(b1)=0 */
};

/* -------------------------------------------------------------------- *
 * 500 sps: CLKDIV /1 (field 0), tick 250 ns, PRPCT 7999 (frame 8000 ticks = 2000 us)
 * NUMAV 5 (6 averages) -> convert >= 365.00 us = 1460 ticks; sample 100 us = 280 ticks
 * dynamic power-down: off
 * -------------------------------------------------------------------- */
static const afe_regval_t afe_regs_500[] = {
    { 0x39, 0x000000 }, /* CLKDIV_PRF   = 0: divide-by-1, tick = 250 ns (codes 1,2,3 forbidden) */
    { 0x01, 0x000064 }, /* LED2STC      =   100 (    25.00 us)  RED sample start */
    { 0x02, 0x00017B }, /* LED2ENDC     =   379 (    94.75 us)  RED sample end: 280 ticks = 70.00 us */
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    { 0x23, 0x000200 }, /* CONTROL2: OSC_ENABLE(b9); ILED_2X(b17)=0 ALWAYS, PDNAFE(b0)=PDNRX(b1)=0 */
};

/* Indexed by nc_rate_t. NUMAV is applied by the driver via CONTROL1
 * (0x1E) = TIMEREN(b8) | NUMAV[3:0], written LAST after the table. */
static const afe_rate_cfg_t AFE_RATE_TABLE[5] = {
    /* [0] NC_RATE_50  */ {  50, 4, 39999, 15, 20000, true,  afe_regs_50, 36 },
    /* [1] NC_RATE_100 */ { 100, 0, 39999, 15, 10000, true,  afe_regs_100, 36 },
    /* [2] NC_RATE_200 */ { 200, 0, 19999, 15,  5000, false, afe_regs_200, 36 },
    /* [3] NC_RATE_250 */ { 250, 0, 15999, 15,  4000, false, afe_regs_250, 36 },
    /* [4] NC_RATE_500 */ { 500, 0,  7999,  5,  2000, false, afe_regs_500, 36 },
};
